## drivers/devdetect/Kconfig
```kconfig
#/* < DTS2011052606009 jiaxianghong 20110527 begin */
#/* <DTS2011032104626 shenjinming 20110321 begin */

#
# Near Field Communication (NFC) devices
#

config HUAWEI_HW_DEV_DCT
	default y
	bool "HUAWEI DEVICE DETECT"
	help
		Say yes if you want i2c device detect driver.
		This is for i2c connected version. If unsure, say N here.

#/* <DTS2011032104626 shenjinming 20110321 end> */
#/* < DTS2011052606009 jiaxianghong 20110527 end */
```

## drivers/i2c/chips/Kconfig
```kconfig
#
# Miscellaneous I2C chip drivers configuration
#
# *** DEPRECATED! Do not add new entries! See Makefile ***
#

menu "Miscellaneous I2C Chip support"

config SENSORS_MT9T013
	tristate "MT9T013 Camera Driver"
	depends on I2C
	default y
	help
	 MT9T013 Camera Driver implemented by HTC.

#/* < DTS2010061100003 luojianhong 201000612 begin*/
config HUAWEI_FEATURE_TPA2028D1_AMPLIFIER
	tristate "tpa2028d1 amplifier"
	depends on HUAWEI_KERNEL
	default y
	help
	 tpa2028d1 amplifier used for audio.
#/*  DTS2010061100003 luojianhong 201000612 end > */

#/* <BU5D07680 liujinggang 20100413 begin */
config HUAWEI_FEATURE_SENSORS_ST_LSM303DLH
	tristate "LSM303DLH is a 6D sensors(gs&ms)"
	depends on HUAWEI_KERNEL
	default n
	help
	 The LSM303DLH is a system-in-package featuring a 3D
	 digital linear acceleration sensor and a 3D digital magnetic sensor.
#/* BU5D07680 liujinggang 20100413 end> */
#/* < DTS2011042703449  liujinggang 20110427 begin */
config HUAWEI_FEATURE_SENSORS_AK8975
	tristate "AK8975"
	depends on HUAWEI_KERNEL
	default n
	help
	  If you say yes here you get support for Asahi Kasei's 
	  orientation sensor AK8975.
#/* DTS2011042703449  liujinggang 20110427 end > */
endmenu
```

## drivers/input/accelerometer/Kconfig
```kconfig
#
# accelerometer driver configuration
#
menuconfig HUAWEI_FEATURE_INPUT_ACCELEROMETER
	bool "Accelerometer"
	depends on HUAWEI_KERNEL = y
	default n 
	help
	  Say Y here, and a list of supported ACCELEROMETERs will be displayed.
	  This option doesn't affect the kernel.

	 

#/* < DTS2011043000257  liujinggang 20110503 begin */
if HUAWEI_FEATURE_INPUT_ACCELEROMETER

config HUAWEI_FEATURE_ACCELEROMETER_ADXL345
	tristate "ADI ADXL345 accelerometer"	
	select SERIO
	depends on HUAWEI_KERNEL = y
	default n 
	help
	  Say Y here if you have the ADXL345 accelerometer.

	  
config HUAWEI_FEATURE_ACCELEROMETER_ST_L1S35DE
	tristate "ST LIS35DE accelerometer"	
	select SERIO
	depends on HUAWEI_KERNEL = y
	default n 
	help
	  Say Y here if you have the ST LIS35DE accelerometer.
#BK4D00610, add  freescale config, dingxifeng KF14049, 2009-5-25 begin#
#/* < DTS2011042703449  liujinggang 20110427 begin */
config HUAWEI_FEATURE_SENSORS_ACCELEROMETER_MMA8452
	tristate "FREESCALE MMA8452 accelerometer"
	select SERIO
	help
	  Say Y here if you have the FREESCALE MMA8452 accelerometer.

config HUAWEI_FEATURE_SENSORS_ACCELEROMETER_BOSCH_BMA250
	tristate "BOSCH BMA250 accelerometer"
	select SERIO
	help
	  Say Y here if you have the BOSCH BMA250 accelerometer.
config HUAWEI_FEATURE_SENSORS_ACCELEROMETER_ADI_ADXL346
	tristate "ADI ADXL346 accelerometer"
	select SERIO
	help
	  Say Y here if you have the ADI ADXL346 accelerometer.

config HUAWEI_FEATURE_SENSORS_ACCELEROMETER_ST_LIS3XH
	tristate "ST LIS3DH and LIS331DLH accelerometer"	
	select SERIO
	help
	  Say Y here if you have the ST LIS3DH and LIS331DLH accelerometer.
#/* DTS2011042703449  liujinggang 20110427 end > */
endif
#/* DTS2011043000257  liujinggang 20110503 end > */
```

## drivers/media/video/msm/Kconfig
```kconfig
config MSM_CAMERA_V4L2
        bool "MSM Camera V4L2 Interface"
        depends on MSM_CAMERA
        default n
        ---help---
          This flag enables V4L2 interface of MSM
          camera driver. If enabled, application interacts
          with /dev/video0 through V4L2 APIs. Otherwise,
          native APIs are used through /dev/config0, /dev/frame0,
          and /dev/control0.

comment "Camera Sensor Selection"
config MT9T013
	bool "Sensor mt9t013 (BAYER 3M)"
	depends on MSM_CAMERA && !ARCH_MSM8X60 && !MSM_CAMERA_V4L2
	default y
	---help---
	  MICRON 3M Bayer Sensor with AutoFocus

config MT9D112
	bool "Sensor mt9d112 (YUV 2M)"
	depends on MSM_CAMERA && !ARCH_MSM8X60 && !MSM_CAMERA_V4L2
	default y
	---help---
	  MICRON 2M YUV Sensor
	    
	  
#/*<BU5D09497  lijuan 00152865  20100514 begin*/
config  HUAWEI_CAMERA
	bool "Select huawei camera"
	depends on MSM_CAMERA
	depends on HUAWEI_KERNEL
	default y
	---help---
	  Select huawei camera
#/* BU5D09497  lijuan 00152865  20100514 end> */

#/*< DTS2011051400258   songxiaoming 20110514 begin */
config HUAWEI_SENSOR_HI701
	bool "Sensor Hynix (YUV 30W)"
	depends on HUAWEI_CAMERA
	default y
	---help---
	  Hynix 30w YUV Sensor
#/* DTS2011051400258   songxiaoming 20110514 end > */

#/*<  DTS2011101000840   yuguangcai 20111010 begin */
config HUAWEI_SENSOR_S5K5CA
	bool "Sensor s5k5ca (YUV 3M)"
	depends on HUAWEI_CAMERA
	default y
	---help---
	  SUNNY 3M YUV Sensor
#/* DTS2011101000840   yuguangcai 20111010 end > */
#/*< DTS2011102805854 yuguangcai 20111031 begin */
config HUAWEI_SENSOR_MT9T113
	bool "Sensor mt9t113 (YUV 3M)"
	depends on HUAWEI_CAMERA
	default n
	---help---
	  Aptina 3M YUV Sensor
#/* DTS2011102805854 yuguangcai 20111031 end > */
#/* < DTS2011081301650 liwei 20110813 begin */
config HUAWEI_SENSOR_OV7690
	bool "Sensor ov7690 (YUV 30K)"
	depends on HUAWEI_CAMERA
	default y
	---help---
	  MICRON 30k YUV Sensor
#/* DTS2011081301650 liwei 20110813 end > */

#/*<BU5D10275  liyuping 00166065 20100529 begin*/

#/*< DTS2011072600848   songxiaoming 20110726 begin */
config HUAWEI_SENSOR_OV7736
	bool "Sensor ov7736 (YUV 30W)"
	depends on HUAWEI_CAMERA
	default y
	---help---
	  MICRON 30W YUV Sensor
#/* DTS2011072600848   songxiaoming 20110726 end > */
	  
config HUAWEI_SENSOR_HIMAX0356
	bool "Sensor himax (YUV 30W)"
	depends on HUAWEI_CAMERA
	default y
	---help---
	  HIMAX 30w YUV Sensor
#/* BU5D10275  liyuping 00166065 20100529 end> */

#/*<DTS2011042704563 penghai 20110427 begin*/
config HUAWEI_SENSOR_MT9D113
	bool "Sensor Aptina (YUV 200W)"
	depends on HUAWEI_CAMERA
	default y
	---help---
	  Aptina 200w YUV Sensor
#/*DTS2011042704563 penghai 20110427 end>*/

#/* < DTS2011061801881 zhangyu 20110620 BEGIN */
config HUAWEI_SENSOR_MT9V114
	bool "Sensor Aptina (YUV 30W)"
	depends on HUAWEI_CAMERA
	default y
	---help---
	  Aptina 30w YUV Sensor
	  
#/* DTS2011061801881 zhangyu 20110620 END > */ 

#/* < DTS2011100802746 zhangyu 20111010 begin */
config HUAWEI_SENSOR_S5K4E1GX
	bool "Sensor s5k4e1gx (BAYER 5M)"
	depends on HUAWEI_CAMERA
	default n
	---help---
	  MICRON 5M Bayer Sensor with AutoFocus

config HUAWEI_SENSOR_S5K4E1GX_P
	bool "Sensor s5k4e1gx (BAYER 5M)"
	depends on HUAWEI_CAMERA
	default n
	---help---
	  MICRON 5M Bayer Sensor with AutoFocus
	  
#/* < DTS2011090701903 zhangyu 20110907 begin */
config HUAWEI_SENSOR_MT9P017
	bool "Sensor mt9p017 (BAYER 5M)"
	depends on HUAWEI_CAMERA
	default n
	---help---
	  MICRON 5M Bayer Sensor with AutoFocus
#/* DTS2011090701903 zhangyu 20110907 end > */ 
#/* DTS2011100802746 zhangyu 20111010 end > */ 
	  
#/*<BU5D09497  lijuan 00152865  20100514 begin*/	  
config HUAWEI_SENSOR_OV5647_SUNNY
	bool "Sensor ov5647_sunny (BAYER 5M)"
	depends on HUAWEI_CAMERA
	default y
	---help---
	  MICRON 5M Bayer Sensor with AutoFocus
#/* BU5D09497  lijuan 00152865  20100514 end> */
#/* < DTS2010092501047 luojianhong 201000926 begin*/	  
config HUAWEI_FEATURE_RIGHT_TPA2028D1_AMPLIFIER
	tristate "right tpa2028d1 amplifier"
	depends on HUAWEI_KERNEL
	default y
	---help---
	  tpa2028d1 amplifier used for audio.
#/*  DTS2010092501047 luojianhong 201000926 end > */
config IMX074
	bool "Sensor IMX074 (BAYER 13.5M)"
	depends on MSM_CAMERA && ARCH_MSM8X60 && !MSM_CAMERA_V4L2
	default y
	---help---
	SONY 13.5 MP Bayer Sensor
config WEBCAM_OV7692
	bool "Sensor OV7692 (VGA YUV)"
	depends on MSM_CAMERA && ARCH_MSM8X60 && !MSM_CAMERA_V4L2
	default y
	---help---
	  Omni Vision VGA YUV Sensor.
#/* < DTS2011081301650 liwei 20110813 begin */
config WEBCAM_OV9726
	bool "Sensor OV9726 (VGA Bayer)"
	depends on MSM_CAMERA && (ARCH_MSM8X60 || ARCH_MSM7X30) && !MSM_CAMERA_V4L2
	default n
	---help---
	  Omni Vision VGA Bayer Sensor.
#/* DTS2011081301650 liwei 20110813 end > */
#	This Senosr is used as a webcam.
#	This uses the CSI interface.
#	Need to enable CSI1 clks for this sensor.
config VX6953
	bool "Sensor VX6953 (BAYER 5M)"
	depends on MSM_CAMERA && ARCH_MSM7X30
	default y
	---help---
	STM 5M Bayer Sensor with EDOF
config SN12M0PZ
	bool "Sensor sn12m0pz (Bayer 12 MP)"
	depends on MSM_CAMERA && ARCH_MSM7X30 && !MSM_CAMERA_V4L2
	default y
	---help---
	  Sony 12 MP Bayer Sensor
config MT9P012
	bool "Sensor mt9p012 (BAYER 5M)"
	depends on MSM_CAMERA && !ARCH_MSM8X60 && !MSM_CAMERA_V4L2
	default y
	---help---
	  MICRON 5M Bayer Sensor with Autofocus

choice
	prompt "AF module"
	depends on MT9P012 && !ARCH_MSM8X60 && !MSM_CAMERA_V4L2
	default MSM_CAMERA_AF_FOXCONN

config MSM_CAMERA_AF_FOXCONN
	bool "FOXCONN Module"
	help
	  This driver supports FOXCONN AF module for 5M Bayer sensor

config MSM_CAMERA_AF_BAM
	bool "BAM Module"
	help
	  This driver supports BAM AF module for 5M Bayer sensor

endchoice

config MT9P012_KM
	bool "Sensor mt9p012 KM module (BAYER 5M)"
	depends on MSM_CAMERA && !ARCH_MSM8X60 && !MSM_CAMERA_V4L2
	default y
	---help---
	  MICRON 5M Bayer Sensor KM modules with Autofocus

config MT9E013
	bool "Sensor mt9e013 module (BAYER 8M)"
	depends on MSM_CAMERA && ARCH_MSM7X30 && !MSM_CAMERA_V4L2
	default y
	---help---
	  Aptina 8M Bayer Sensor modules with Autofocus

#/*<DTS2011042704563 penghai 20110427 begin*/
config HUAWEI_SENSOR_MT9E013
	bool "Sensor mt9e013 module (BAYER 8M)"
	depends on HUAWEI_CAMERA
	default y
	---help---
	  Aptina 8M Bayer Sensor modules with Autofocus
#/*DTS2011042704563 penghai 20110427 end>*/

config S5K3E2FX
	bool "Sensor s5k3e2fx (Samsung 5M)"
	depends on MSM_CAMERA && !ARCH_MSM8X60 && !MSM_CAMERA_V4L2
	default y
	---help---
	  Samsung 5M with Autofocus

config VB6801
	bool "Sensor vb6801"
	depends on MSM_CAMERA && !ARCH_MSM8X60 && !MSM_CAMERA_V4L2
	---help---
	  5M with flash

config MSM_CAMERA_FLASH
	bool "Qualcomm MSM camera flash support"
	depends on MSM_CAMERA
	default y
	---help---
	  Enable support for LED flash for msm camera

#/*< DTS2011091402372   yuguangcai 20110914 begin */
config HUAWEI_FEATURE_TPS61310
	tristate "TPS61310"
	depends on HUAWEI_KERNEL
	default n
	help
	  tps61310 LED camera flash and video light
#/* DTS2011091402372   yuguangcai 20110914 end > */
#/* < DTS2011072705129 xiangxu 20110728 begin */
config HW_TORCH
	bool "HUAWEI torch support"
	depends on MSM_CAMERA_FLASH
	default n
	---help---
	  Enable support for LED flash for torch
#/* DTS2011072705129 xiangxu 20110728 end > */
config MSM_GEMINI
	tristate "Qualcomm MSM Gemini Jpeg Engine support"
	depends on MSM_CAMERA && (ARCH_MSM7X30 || ARCH_MSM8X60)
	default M
	---help---
	  Enable support for Gemini Jpeg Engine

config MSM_VPE
	tristate "Qualcomm MSM Video Pre-processing Engine support"
	depends on MSM_CAMERA && (ARCH_MSM7X30 || ARCH_MSM8X60)
	default y
	---help---
	  Enable support for Video Pre-processing Engine

config QUP_EXCLUSIVE_TO_CAMERA
	bool "QUP exclusive to camera"
	depends on MSM_CAMERA
	default y
	---help---
	  This flag enabled states that QUP
	  is exclusive to camera. In case this
	  is disabled, the lvs1 voltage is enabled
	  by QUP in the board file as QUP is used by
	  applications other than camera.
```

## drivers/nfc/Kconfig
```kconfig
# /* < DTS2011042602168 caomingxing 20110426 begin */
# /*< DTS2011011904316 genghua 20110121 begin */
#
# Near Field Communication (NFC) devices
#

config HUAWEI_NFC_PN544
	default n
	bool "HUAWEI NFC PN544"
	help
		Say yes if you want PN544 Near Field Communication driver.
		This is for i2c connected version. If unsure, say N here.

# /* DTS2011011904316 genghua 20110121 end >*/
# /* DTS2011042602168 caomingxing 20110426 end > */
```

## drivers/video/msm/Kconfig
```kconfig
source "drivers/video/msm/vidc/Kconfig"

config FB_MSM
	tristate
	depends on FB && ARCH_MSM
	select FB_CFB_FILLRECT
	select FB_CFB_COPYAREA
	select FB_CFB_IMAGEBLIT
	default y

config FB_MSM_LCDC
	bool "Support for integrated LCD controller in qsd8x50"
	depends on FB_MSM && MSM_MDP31
	default y
	
#/*< DTS2011072500979 jiaoshuangwei 20110725 begin */
#/* add the code for dynamic gamma function */
config FB_DYNAMIC_GAMMA
	bool "Support for DYNAMIC_GAMMA fuction of glory"
	depends on FB_MSM
#/*< DTS2011081601583 pengyu 20110816 begin */
#/* change default state to 'n', move this config to hw7x30_defconfig */
	default n
#/* DTS2011081601583 pengyu 20110816 end >*/
#/* DTS2011072500979 jiaoshuangwei 20110725 end >*/

#/*< DTS2011081800466 pengyu 20110818 begin */
#/* Add code for automatic CABC function */
config FB_AUTO_CABC
	bool "Support for AUTO_CABC fuction"
	depends on FB_MSM
	default n
#/* DTS2011081800466 pengyu 20110818 end >*/
```
